/*
 *  DTSU666ModbusSniffer.cpp
 *
 *  The program listens to the DTSU666 reply and show values on a 1602 LCD display.
 *  The requests are generated by a Deye inverter.
 *
 *  Because Modbus protocol is a master slave one, we can listen to the TX and RX of the communication
 *  by connecting both with a schottky diode to the Arduino RX pin.
 *
 * Apply EMA lowpass alpha = 0.03125 | 1/32 to the power values.
 * Cutoff frequency is 0.051 Hz @10Hz.
 * https://github.com/ArminJo/Arduino-Utils?tab=readme-ov-file#simpleemafilters
 * Skip lowpass if delta is more than 12 % (guessed value),
 * otherwise we see a slow increasing value at a power jump, caused by switching a load.
 * The character '_' indicates a filtered value
 *
 *
 *  Copyright (C) 2023-2024  Armin Joachimsmeyer
 *  Email: armin.joachimsmeyer@gmail.com
 *
 *  This file is part of ArduinoUtils https://github.com/ArminJo/PVUtils.
 *
 *  Arduino-Utils is free software: you can redistribute it and/or modify
 *  it under the terms of the GNU General Public License as published by
 *  the Free Software Foundation, either version 3 of the License, or
 *  (at your option) any later version.
 *
 *  This program is distributed in the hope that it will be useful,
 *  but WITHOUT ANY WARRANTY; without even the implied warranty of
 *  MERCHANTABILITY or FITNESS FOR A PARTICULAR PURPOSE.
 *  See the GNU General Public License for more details.
 *
 *  You should have received a copy of the GNU General Public License
 *  along with this program. If not, see <http://www.gnu.org/licenses/gpl.html>.
 */

#include <Arduino.h>

#include "LongUnion.h"

#define VERSION_EXAMPLE "1.2"

#define MODBUS_BAUDRATE                 9600
//#define STANDALONE_TEST               // If activated, random power is displayed on LCD.
#define DEBUG_PIN                       3 // If low, print raw protocol data. Pin 2 is left for a future button.
#define DIRECT_PIN                      4 // If low, data printed on LCD is not lowpass filtered.

#define MODBUS_MINIMUM_FRAME_LENGTH     7 // 0x01 0x03 0x02 0x00 0x00 0xB8 0x44 - Reply of one 16 bit word
#define MODBUS_REQUEST_FRAME_LENGTH     8 // /*ID*/ 0x01 /*FUNCTION*/ 0x03 /*ADDR*/ 0x00 0x13 /*NUMBER*/ 0x00 0x01 /*CRC*/ 0x75 0xCF

#define MODBUS_ID_INDEX                 0
#define MODBUS_FUNCTION_INDEX           1
#define MODBUS_REQUEST_ADDRESS_INDEX    2
#define MODBUS_REQUEST_NUMBER_INDEX     4
#define MODBUS_REPLY_LENGTH_INDEX       2
#define MODBUS_REPLY_DATA_INDEX         3
#define MODBUS_RECEIVE_INTRA_FRAME_SILENCE_MILLISECONDS     3 // Standard says: 3.5 character, which is 4 ms at 9600 baud. Then I can check CRC and switch to 105200 for log sending.
#define MODBUS_RECEIVE_INTRA_REQUEST_GAP_MILLISECONDS       100 // Between sending of Modbus request and answer and new request I observed around 25 ms.

#define MODBUS_FRAME_TYPE_CRC_ERROR     0
#define MODBUS_FRAME_TYPE_REQUEST       1
#define MODBUS_FRAME_TYPE_REPLY         2

struct ModbusFrameInfoStruct {
//    uint16_t RegisterAddress;
//    uint16_t RequestRegisterRange;
    uint8_t ReplyBytes;
    uint8_t FrameType;              // One of MODBUS_FRAME_TYPE_CRC_ERROR, MODBUS_FRAME_TYPE_REQUEST, MODBUS_FRAME_TYPE_REPLY
    uint8_t RXBuffer[128];          // 90 bytes is the maximum I saw
    uint16_t RXBufferIndex = 0;     // Index of next byte to write to array. Starting with 0.
    uint32_t MillisOfLastReceivedByte;
} sModbusFrameInfo;

//bool sValuesPrinted = true;
int16_t sPower[3];
int16_t sPowerLowpass4[4];


void dumpBuffer();
void readModbusByte();
void processModbusPDUFrame(bool tPrintBuffers);
// Content specific function
void interpreteModbusPDUContent();
void printDataToSerialAndLCD();
void printDataToLCD();
void blinkForever();
uint16_t calculateCrc(uint8_t *aBuffer, uint16_t aBufferLength);

/*
 * LCD stuff
 */
#define LCD_COLUMNS     16
#define LCD_ROWS         2
#define LCD_I2C_ADDRESS 0x27     // Default LCD address is 0x27 for a I2C to LCD converter
#include "LiquidCrystal_I2C.hpp" // This defines USE_SOFT_I2C_MASTER, if SoftI2CMasterConfig.h is available. Use the modified version delivered with this program!
LiquidCrystal_I2C myLCD(LCD_I2C_ADDRESS, LCD_COLUMNS, LCD_ROWS);
bool sSerialLCDAvailable;
char sStringBufferForLCDRow[LCD_COLUMNS + 1]; // For rendering LCD lines with sprintf()

// Helper macro for getting a macro definition as string
#define STR_HELPER(x) #x
#define STR(x) STR_HELPER(x)

void setup() {
// initialize the digital pin as an output.
    pinMode(LED_BUILTIN, OUTPUT);
    digitalWrite(LED_BUILTIN, LOW);

    pinMode(DEBUG_PIN, INPUT_PULLUP);
    pinMode(DIRECT_PIN, INPUT_PULLUP);

    Serial.begin(115200);

#if defined(__AVR_ATmega32U4__) || defined(SERIAL_PORT_USBVIRTUAL) || defined(SERIAL_USB) /*stm32duino*/|| defined(USBCON) /*STM32_stm32*/ \
    || defined(SERIALUSB_PID)  || defined(ARDUINO_ARCH_RP2040) || defined(ARDUINO_attiny3217)
    delay(4000); // To be able to connect Serial monitor after reset or power up and before first print out. Do not wait for an attached Serial Monitor!
#endif
    // Just to know which program is running on my Arduino
    Serial.println(F("START " __FILE__ "\r\nVersion " VERSION_EXAMPLE " from " __DATE__));
    Serial.println(F("Data is printed with 115200 baud during the 7 seconds gap between the logger requests."));
    Serial.println(F("If you connect debug pin " STR(DEBUG_PIN) " to ground, raw protocol data is printed"));
    Serial.println(F("If you connect direct pin " STR(DIRECT_PIN) " to ground, data printed on LCD is not lowpass filtered."));
    Serial.println(F("Wait for 9600 baud modbus data on RX"));

    /*
     * Initialize I2C and check for bus lockup
     */
    if (!i2c_init()) {
        Serial.println(F("I2C init failed"));
    }
    /*
     * Check for LCD connected
     */
    sSerialLCDAvailable = i2c_start(LCD_I2C_ADDRESS << 1);
    i2c_stop();

    if (sSerialLCDAvailable) {
        /*
         * Print program, version and date on the upper two LCD lines
         */
        myLCD.init();
        myLCD.clear();
        myLCD.backlight();
        myLCD.setCursor(0, 0);
        myLCD.print(F("Modbus Sniffer"));
        myLCD.setCursor(0, 1);
        myLCD.print(F(VERSION_EXAMPLE " " __DATE__));
        delay(2000);
        myLCD.setCursor(0, 1);
        myLCD.print(F("Debug pin = " STR(DEBUG_PIN) "   "));
        delay(1000);
        myLCD.setCursor(0, 1);
        myLCD.print(F("Direct pin = " STR(DIRECT_PIN) "  "));
        delay(1000);
        myLCD.setCursor(0, 1);
#if defined(STANDALONE_TEST)
        myLCD.print(F("Standalone test "));
#else
        myLCD.print(F("Wait for RX data"));
#endif
        delay(1000);

    } else {
        Serial.println(F("No I2C 2004 LCD connected at address " STR(LCD_I2C_ADDRESS)));
        blinkForever();
    }

    Serial.println();
    Serial.flush();
    Serial.begin(MODBUS_BAUDRATE);
}

/*
 * Check for 9600 baud signal at RX and store it in buffer.
 */
bool sPrintNonFilteredValues;
void loop() {

#if defined(STANDALONE_TEST)
    sPower[0] = random(-1111,3333);
    sPower[1] = random(-1111,3333);
    sPower[2] = random(-1111,3333);
    if (sSerialLCDAvailable) {
        printDataToLCD();
    }
    delay(3000);
#else
    bool tPrintBuffers = !digitalRead(DEBUG_PIN);
    sPrintNonFilteredValues = !digitalRead(DIRECT_PIN);

//    if (!sValuesPrinted
//            && sModbusFrameInfo.RXBufferIndex
//                    == 0&& (millis() - sModbusFrameInfo.MillisOfLastReceivedByte) > MODBUS_RECEIVE_INTRA_REQUEST_GAP_MILLISECONDS) {
//        /*
//         * We are in the 7 seconds gap here :-)
//         */
//        printDataToSerialAndLCD();
//    }

    /*
     * Try to read byte if buffer empty or last byte was received just before - otherwise we have a timeout signaling end of modbus frame
     */
    if (sModbusFrameInfo.RXBufferIndex
            == 0|| (millis() - sModbusFrameInfo.MillisOfLastReceivedByte) < MODBUS_RECEIVE_INTRA_FRAME_SILENCE_MILLISECONDS) {
        /*
         * Modbus byte is expected, test and read
         */
        readModbusByte();
    } else {
        /*
         * We are in a gap between request and reply ore vice versa.
         * Time to interpret buffer and print raw log output if debug pin is low.
         */
        processModbusPDUFrame(tPrintBuffers);
        if (sModbusFrameInfo.FrameType == MODBUS_FRAME_TYPE_REPLY) {
            interpreteModbusPDUContent();
            printDataToSerialAndLCD();
            //        sValuesPrinted = false; // enable new print
        }
    }
#endif
}

void readModbusByte() {
    /*
     * Modbus byte is expected, test and read
     */
    if (Serial.available()) {
        uint8_t tReceivedValue = Serial.read();
        sModbusFrameInfo.RXBuffer[sModbusFrameInfo.RXBufferIndex] = tReceivedValue;
// avoid buffer overflow
        if (sModbusFrameInfo.RXBufferIndex < sizeof(sModbusFrameInfo.RXBuffer) - 1) {
            sModbusFrameInfo.RXBufferIndex++;
        }
        sModbusFrameInfo.MillisOfLastReceivedByte = millis();
    }
}

/*
 * Interpret PDU and print raw log output if debug pin is low.
 * Do not check for CRC!!!
 */
void processModbusPDUFrame(bool tPrintBuffers) {
    if (sModbusFrameInfo.RXBufferIndex >= MODBUS_MINIMUM_FRAME_LENGTH) {
        if (tPrintBuffers) {
            Serial.begin(115200);
        }
        /*
         * Decide if request or reply frame
         */
        if (sModbusFrameInfo.RXBufferIndex == MODBUS_REQUEST_FRAME_LENGTH) {
            /*
             * Request frame here
             */
            sModbusFrameInfo.FrameType = MODBUS_FRAME_TYPE_REQUEST;
//            sModbusFrameInfo.RegisterAddress = sModbusFrameInfo.RXBuffer[MODBUS_REQUEST_ADDRESS_INDEX] << 8
//                    | sModbusFrameInfo.RXBuffer[MODBUS_REQUEST_ADDRESS_INDEX + 1];
//            sModbusFrameInfo.RequestRegisterRange = sModbusFrameInfo.RXBuffer[MODBUS_REQUEST_NUMBER_INDEX] << 8
//                    | sModbusFrameInfo.RXBuffer[MODBUS_REQUEST_NUMBER_INDEX + 1];
            if (tPrintBuffers) {
                Serial.print(F("Request="));
//                Serial.print(sModbusFrameInfo.RegisterAddress, HEX);
//                Serial.print(F(", L="));
//                Serial.print(sModbusFrameInfo.RequestRegisterRange);
            }

        } else {
            /*
             * Assume reply frame
             */
            sModbusFrameInfo.ReplyBytes = sModbusFrameInfo.RXBuffer[MODBUS_REPLY_LENGTH_INDEX];
            uint16_t tComputedCRC = calculateCrc(sModbusFrameInfo.RXBuffer, sModbusFrameInfo.ReplyBytes + 3);
            if (tComputedCRC
                    == (uint16_t) (sModbusFrameInfo.RXBuffer[sModbusFrameInfo.RXBufferIndex - 2] << 8
                            | sModbusFrameInfo.RXBuffer[sModbusFrameInfo.RXBufferIndex - 1])) {
                sModbusFrameInfo.FrameType = MODBUS_FRAME_TYPE_REPLY;

                if (tPrintBuffers) {
                    Serial.print(F("Reply="));
                }
            } else {
                // CRC Error here
                sModbusFrameInfo.FrameType = MODBUS_FRAME_TYPE_CRC_ERROR;
                myLCD.setCursor(0, 0);
                myLCD.print('C');
            }

        }
        if (tPrintBuffers) {
            dumpBuffer();
            Serial.println();
            Serial.flush();
            Serial.begin(MODBUS_BAUDRATE);
        }
    }
// prepare for next receiving of request or reply
    sModbusFrameInfo.RXBufferIndex = 0;
}

/*
 * Deye Request frame 8 ms every 100 ms -> Reply frame 18 ms
 * 01 03  15 1E  00 06  A1 C2 -> 01 03 0C  00 00 00 00  00 00 00 00  00 00 00 00  93 70
 * At address 15 1E Deye expects float power values in kW units
 */
void interpreteModbusPDUContent() {
    LongUnion tPower;
    uint8_t tReplyBufferIndex = MODBUS_REPLY_DATA_INDEX;
    for (uint_fast8_t i = 0; i < 3; ++i) {
        // Reverse bytes. We received MSB . . LSB
        for (int_fast8_t j = 3; j >= 0; j--) {
            tPower.UBytes[j] = sModbusFrameInfo.RXBuffer[tReplyBufferIndex++];
        }
        sPower[i] = tPower.Float * 1000.0; // At address 15 1E Deye expects float power values in kW units
    }
}

/*
 * Dump buffer, 3 character per byte
 */
void dumpBuffer() {
    Serial.print(F("0x"));
    for (uint_fast8_t i = 0; i < sModbusFrameInfo.RXBufferIndex; i++) {
        Serial.print(sModbusFrameInfo.RXBuffer[i], HEX);
        Serial.print(F(" "));
    }
}

/*
 * Print data to serial and LCD
 */
void printDataToSerialAndLCD() {
//    Serial.begin(115200);
//    Serial.println();
//
//    Serial.println();
//    Serial.flush();
//    Serial.begin(MODBUS_BAUDRATE);

    if (sSerialLCDAvailable) {
        printDataToLCD();
    }
//    sValuesPrinted = true;
}

/*
 * Apply EMA lowpass alpha = 0.03125 | 1/32 to the power values.
 * Cutoff frequency is 0.051 Hz @10Hz.
 * https://github.com/ArminJo/Arduino-Utils?tab=readme-ov-file#simpleemafilters
 * Skip lowpass if delta is more than 12 % (guessed value),
 * otherwise we see a slow increasing value at a power jump, caused by switching a load.
 * The character '_' indicates a filtered value
 */
void printPowerToLCD(int16_t &aPowerLowpass5, int16_t aPower) {
    if (!sPrintNonFilteredValues) {
        if (abs(aPowerLowpass5 - aPower) > abs(aPowerLowpass5 / 4)) {
            aPowerLowpass5 = aPower; // Fast response, reinitialize lowpass.
            sprintf_P(sStringBufferForLCDRow, PSTR("%6d W"), aPowerLowpass5); // force use of 6 columns
        } else {
            aPowerLowpass5 += ((aPower - aPowerLowpass5) + (1 << 4)) >> 5; // 2.5 us, alpha = 1/32 0.03125, cutoff frequency 5.13 Hz @1kHz
            sprintf_P(sStringBufferForLCDRow, PSTR("%6d_W"), aPowerLowpass5); // force use of 6 columns
        }
    } else {
        aPowerLowpass5 = aPower; // Required for sum.
        sprintf_P(sStringBufferForLCDRow, PSTR("%6d W"), aPower); // force use of 6 columns
    }
    /*
     * 11 ms. 6 ms with delayMicroseconds(40); and 3.4 ms with delayMicroseconds(2) instead of delayMicroseconds(100);
     * commands need > 37us to settle
     * Called every MILLISECONDS_BETWEEN_LCD_OUTPUT (320 ms)
     */
    myLCD.print(sStringBufferForLCDRow);
}

void printDataToLCD() {
    myLCD.setCursor(0, 0);

    printPowerToLCD(sPowerLowpass4[0], sPower[0]);
    printPowerToLCD(sPowerLowpass4[1], sPower[1]);

    myLCD.setCursor(0, 1);
    printPowerToLCD(sPowerLowpass4[2], sPower[2]);
    printPowerToLCD(sPowerLowpass4[3], sPowerLowpass4[0] + sPowerLowpass4[1] + sPowerLowpass4[2]); // Print sum of all
    if (sPrintNonFilteredValues) {
        myLCD.setCursor(0, 1);
        myLCD.print('U'); // Direct/Unfiltered values requested
    }

}

void blinkForever() {
    while (true) {
        digitalWrite(LED_BUILTIN, !digitalRead(LED_BUILTIN));
        delay(500);
    }
}

/* Table of CRC values for high-order byte */
#if defined(ARDUINO) && defined(__AVR__)
static PROGMEM const uint8_t CRCHighTable[] = {
#else
const uint8_t CRCHighTable[] = {
#endif
        0x00, 0xC1, 0x81, 0x40, 0x01, 0xC0, 0x80, 0x41, 0x01, 0xC0, 0x80, 0x41, 0x00, 0xC1, 0x81, 0x40, 0x01, 0xC0, 0x80, 0x41,
        0x00, 0xC1, 0x81, 0x40, 0x00, 0xC1, 0x81, 0x40, 0x01, 0xC0, 0x80, 0x41, 0x01, 0xC0, 0x80, 0x41, 0x00, 0xC1, 0x81, 0x40,
        0x00, 0xC1, 0x81, 0x40, 0x01, 0xC0, 0x80, 0x41, 0x00, 0xC1, 0x81, 0x40, 0x01, 0xC0, 0x80, 0x41, 0x01, 0xC0, 0x80, 0x41,
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        0x00, 0xC1, 0x81, 0x40, 0x01, 0xC0, 0x80, 0x41, 0x01, 0xC0, 0x80, 0x41, 0x00, 0xC1, 0x81, 0x40 };

/* Table of CRC values for low order-byte */
#if defined(ARDUINO) && defined(__AVR__)
static PROGMEM const uint8_t CRCLowTable[] = {
#else
const uint8_t CRCLowTable[] = {
#endif
        0x00, 0xC0, 0xC1, 0x01, 0xC3, 0x03, 0x02, 0xC2, 0xC6, 0x06, 0x07, 0xC7, 0x05, 0xC5, 0xC4, 0x04, 0xCC, 0x0C, 0x0D, 0xCD,
        0x0F, 0xCF, 0xCE, 0x0E, 0x0A, 0xCA, 0xCB, 0x0B, 0xC9, 0x09, 0x08, 0xC8, 0xD8, 0x18, 0x19, 0xD9, 0x1B, 0xDB, 0xDA, 0x1A,
        0x1E, 0xDE, 0xDF, 0x1F, 0xDD, 0x1D, 0x1C, 0xDC, 0x14, 0xD4, 0xD5, 0x15, 0xD7, 0x17, 0x16, 0xD6, 0xD2, 0x12, 0x13, 0xD3,
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        0x44, 0x84, 0x85, 0x45, 0x87, 0x47, 0x46, 0x86, 0x82, 0x42, 0x43, 0x83, 0x41, 0x81, 0x80, 0x40 };

uint16_t calculateCrc(uint8_t *aBuffer, uint16_t aBufferLength) {
    uint8_t tCRCHigh = 0xFF; /* high CRC byte initialized */
    uint8_t tCRCLow = 0xFF; /* low CRC byte initialized */
    unsigned int i; /* will index into CRC lookup */

    /* pass through message buffer */
    while (aBufferLength--) {
        i = tCRCHigh ^ *aBuffer++; /* calculate the CRC  */
#if defined(ARDUINO) && defined(__AVR__)
        tCRCHigh = tCRCLow ^ pgm_read_byte_near(CRCHighTable + i);
        tCRCLow = pgm_read_byte_near(CRCLowTable + i);
#else
        tCRCHigh = tCRCLow ^ CRCHighTable[i];
        tCRCLow = CRCLowTable[i];
#endif
    }

    return (tCRCHigh << 8 | tCRCLow);
}
